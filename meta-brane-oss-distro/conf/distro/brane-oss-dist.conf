## meta-brane-oss-distro/conf/distro/brane-oss-dist.conf
```bitbake
# OSS distro with for Brane Audio devices.
require conf/distro/include/brane-dist-base.inc

DISTRO = "brane-oss-dist"
DISTRO_NAME = "Brane OSS Distro"
```

## meta-brane-oss-distro/conf/distro/include/brane-dist-base.inc
```bitbake
require conf/distro/poky.conf

DISTRO_NAME ?= "Brane Base Distro"
# Now using the community kernel.
DISTRO_VERSION = "6.1-fslc-brane"

SDK_VERSION := "${DISTRO_VERSION}-${DATE}"

MAINTAINER = "Brane Audio <OSS@braneaudio.com>"

# POKY_DEFAULT_DISTRO_FEATURES is set in poky/meta-poky/conf/distro/poky.conf.
# We do not want any of the POKY_DEFAULT_DISTRO_FEATURES.  So, we replace it
# with the features we want instead of removing what we do not want and
# appending what we do to the end.
BRANE_DEFAULT_DISTRO_FEATURES = "bluez5 polkit"
POKY_DEFAULT_DISTRO_FEATURES = "${BRANE_DEFAULT_DISTRO_FEATURES}"

DISTRO_FEATURES_BACKFILL_CONSIDERED = "pulseaudio"

DISTRO_FEATURES:remove = "x11 3g nfc pcmcia zeroconf nfs"

SDK_NAME = "${DISTRO}-${TCLIBC}-${SDK_ARCH}-${IMAGE_BASENAME}-${TUNE_PKGARCH}-${DATE}"

SANITY_TESTED_DISTROS =+ " \
            ubuntu-19.10 \n \
            ubuntu-20.04 \n \
            ubuntu-22.04 \n \
            "

ERROR_QA:remove = "version-going-backwards"

INHERIT:remove = "uninative reproducible_build"

LINUXLIBCVERSION = "6.1%"

INIT_MANAGER = "systemd"

PREFERRED_PROVIDER_udev = "systemd"
PREFERRED_PROVIDER_udev-utils = "systemd"
```

## meta-brane-oss-distro/conf/layer.conf
```bitbake
# We have a conf and classes directory, add to BBPATH
BBPATH .= ":${LAYERDIR}"

# We have a packages directory, add to BBFILES
BBFILES += "${LAYERDIR}/recipes-*/*/*.bb \
            ${LAYERDIR}/recipes-*/*/*.bbappend"

BBFILE_COLLECTIONS += "brane-oss-distro"
BBFILE_PATTERN_brane-oss-distro := "^${LAYERDIR}/"
BBFILE_PRIORITY_brane-oss-distro = "6"
LAYERSERIES_COMPAT_brane-oss-distro = "sumo thud zeus dunfell honister kirkstone langdale"

LAYERDEPENDS_brane-oss-distro = "core"
```

## meta-brane-oss/conf/layer.conf
```bitbake
# We have a conf and classes directory, add to BBPATH
BBPATH .= ":${LAYERDIR}"

# We have a packages directory, add to BBFILES
BBFILES += "${LAYERDIR}/recipes-*/*/*.bb \
            ${LAYERDIR}/recipes-*/*/*.bbappend"

BBFILE_COLLECTIONS += "brane-oss"
BBFILE_PATTERN_brane-oss := "^${LAYERDIR}/"
BBFILE_PRIORITY_brane-oss = "6"
LAYERSERIES_COMPAT_brane-oss = "langdale"

LAYERDEPENDS_brane-oss = "core freescale-layer"

HOSTTOOLS_NONFATAL:append = " rsync"

################################################################################
################################################################################
################################################################################
# These are items that we do not want in our build at the current time.

# Temporarily blocking these since moving to 6.1 kernel without moving all recipes
# to latest Yocto release.  Thus, these recipes are being grabbed from meta-brane-oss.
BBMASK += "poky/meta/recipes-kernel/linux-libc-headers/"
BBMASK += "meta-freescale/recipes-kernel/linux/"

# Later recipes that are not available in langdale branch which we want to get
# rid of CVE's.  Thus, we mask off the folders they would normally use to insure
# everything comes from meta-brane-oss layer.
BBMASK += "poky/meta/recipes-connectivity/bluez5/"
BBMASK += "poky/meta/recipes-connectivity/openssl/"
BBMASK += "poky/meta/recipes-core/busybox/"
BBMASK += "poky/meta/recipes-core/dbus/"
BBMASK += "poky/meta/recipes-core/libxml/"
BBMASK += "poky/meta/recipes-core/systemd/"
BBMASK += "poky/meta/recipes-devtools/e2fsprogs/"
BBMASK += "poky/meta/recipes-devtools/elfutils/"
BBMASK += "poky/meta/recipes-support/curl/"
BBMASK += "poky/meta/recipes-support/gnutls/"
BBMASK += "poky/meta/recipes-support/sqlite/"

# Later recipes that are not available in langdale branch which we want to use
# for AirPlay certification.
BBMASK += "meta-openembedded/meta-networking/recipes-protocols/mdns/"

# Later recipes that are not available in langdale branch which we want to use
# to get rid of apparent memory leak (some sort of weirdness where it would
# suddenly take up 300+ MB of memory after running for a few days on the network).
BBMASK += "meta-openembedded/meta-oe/recipes-connectivity/iwd/"
BBMASK += "poky/meta/recipes-core/ell/"

# Later recipe which fixes out of order decoding problem.
BBMASK += "poky/meta/recipes-multimedia/flac/"

# One can mask off a folder like so:
#BBMASK += "poky/meta/recipes-core/systemd/"

# Or one can mask off specific files like so:
#BBMASK += "meta-brane/meta-brane-oss/recipes-bsp/u-boot/u-boot-imx_2020.04.bb"
```

## meta-brane-oss/conf/machine/brane-machine.conf
```bitbake
#TYPE: Machine
#NAME: Brane Audio Generic Machine
#DESCRIPTION: Machine configuration for a generic Brane Audio Speaker.

MACHINEOVERRIDES =. "brane1:brane-release:"

require conf/machine/include/brane-oss-base.inc
# This is in poky/meta/conf/machine/include/.
require conf/machine/include/arm/armv7a/tune-cortexa7.inc

KERNEL_DEVICETREE = "brane_ctrl1.dtb"

# There are patches in the u-boot image files to put in the defconfig.
UBOOT_CONFIG ??= "prod"
UBOOT_CONFIG[prod] = "brane-ctrl1-fixture_defconfig,sdcard"
```

## meta-brane-oss/conf/machine/include/brane-oss-base.inc
```bitbake
# Provides settings for the Brane OSS images.

BRANE_DEFAULT_BOOTLOADER = "u-boot-fslc"

PREFERRED_PROVIDER_u-boot ??= "${BRANE_DEFAULT_BOOTLOADER}"
PREFERRED_PROVIDER_virtual/bootloader ??= "${BRANE_DEFAULT_BOOTLOADER}"

EXTRA_IMAGEDEPENDS += "${BRANE_DEFAULT_BOOTLOADER}"

UBOOT_BINARY ?= "u-boot.imx"
UBOOT_MAKE_TARGET = "u-boot.imx"
UBOOT_SUFFIX ?= "imx"

UBOOT_ENTRYPOINT = "0x80008000"

# Some nxp devices utilize u-boot container support.  At present we do not.
UBOOT_PROVIDES_BOOT_CONTAINER = "0"

# Probably should move to the 7thf version at some point.  Old sabre7d board
# used the 7hf version orignally.  So, that is how we got here.
#DEFAULTTUNE = "cortexa7thf-neon"
DEFAULTTUNE = "cortexa7hf-neon"

# This should put the devicetree binary file in the /boot folder of the image
# with the zImage file.
MACHINE_ESSENTIAL_EXTRA_RDEPENDS:append = " \
   kernel-image \
   kernel-devicetree \
"

# Handle default kernel
PREFERRED_PROVIDER_virtual/kernel ??= "linux-fslc"

# We need to investigate migrating to wic since that is what everything is
# apparently doing.
BRANE_IMAGE_FSTYPES = "tar.bz2 ext4"
IMAGE_FSTYPES ?= "${BRANE_IMAGE_FSTYPES}"

SERIAL_CONSOLES = "115200;ttymxc0"

KERNEL_IMAGETYPE = "zImage"

MACHINE_FEATURES = "usbgadget usbhost vfat alsa pci wifi bluetooth"

# There were many items that we used to define based on stuff in
# meta-freescale/conf/machine/include/imx-base.inc, but we do not use any
# of these any more.
#
# In case you want to see what those overrides were doing they are:
#  MACHINEOVERRIDES =. "mx7:mx7d:imx:use-mainline-bsp:imx-mainline-bsp:"
#  MACHINEOVERRIDES =. "mx7-generic-bsp:mx7-mainline-bsp:"
#  MACHINEOVERRIDES =. "mx7d-generic-bsp:mx7d-mainline-bsp:"
#
# The only interesting things were imx7d-generic-bsp and imx-mainline-bsp grabbed
# some firmware items, but we get our linux firmware differently, and there were
# some firmware items we did not need.

# imx-generic-bsp causes alsa-state to have a freescale specific asound.conf and
# asound.state.  It also is the comaptible machine for linux-fslc and u-boot-fslc.
MACHINEOVERRIDES =. "imx-generic-bsp:"
```
